## CMakeLists.txt
```
# SPDX-License-Identifier: Apache-2.0

cmake_minimum_required(VERSION 3.20.0)
find_package(Zephyr REQUIRED HINTS $ENV{ZEPHYR_BASE})
project(MessagesSubunit)

FILE(GLOB app_sources src/*.c)
target_sources(app PRIVATE ${app_sources})

FILE(GLOB app_sources2 src/*.h)
target_sources(app PRIVATE ${app_sources2})
```

## prj.conf
```kconfig
CONFIG_PRINTK=y
CONFIG_HEAP_MEM_POOL_SIZE=256
```

## src/main.c
```c
/*
 * Copyright (c) 2017 Linaro Limited
 *
 * SPDX-License-Identifier: Apache-2.0
 */
#include <zephyr.h>
#include <device.h>
#include <sys/printk.h>
#include <string.h>
#include <stdio.h>
#include "SPI_sample.h"
#include "I2C_sample.h"
#include "UART_sample.h"
#include "FifoHandler.h"

/* size of stack area used by each thread */
#define STACKSIZE 1024

/* scheduling priority used by each thread */
#define PRIORITY 7

/* threads periodicity in ms*/
#define THREAD_TEMP_PERIODICITY 2000
#define THREAD_ACC_PERIODICITY 1000
#define THREAD_MODEM_PERIODICITY 4000
#define THREAD_FIFO_HANDLER_PERIODICITY 50

/* callback handler for messages coming from virtual acclerometer through SPI */
void readAccSPI(struct messageFrame *msg)
{
	printf("ACC READING = %s\n", msg->payload);
}
/* callback handler for messages coming from virtual temperature sensor through I2C */
void readTempI2C(struct messageFrame *msg)
{
	printf("TEMP READING = %s\n", msg->payload);
}
/* callback handler for messages coming from virtual modem through UART */
void readModemUART(struct messageFrame *msg)
{
	printf("MODEM RESPONSE = %s\n", msg->payload);
}

void main()
{
	/* assigning handlers for different type of messages */
	if (fifo_register_callback(&readTempI2C, MESS_TYPE_A) != ERR_OK)
		printk("callback A assignation failed\n");
	if (fifo_register_callback(&readAccSPI, MESS_TYPE_B) != ERR_OK)
		printk("callback B assignation failed\n");
	if (fifo_register_callback(&readModemUART, MESS_TYPE_C) != ERR_OK)
		printk("callback C assignation failed\n");
}

/* a thread where we get temperature readings from senor on the I2C bus */
void I2C_ConsumerThread(void)
{
	while (1) {
		/* simulation function just for messages subunit testing */
		task_temp_push();
		/* thread periodicity */
		k_msleep(THREAD_TEMP_PERIODICITY);
	}
}

/* same as I2C consumers but an acclerometer simulation through SPI */
void SPI_ConsumerThread(void)
{
	while (1) {
		task_acc_push();
		/* thread periodicity */
		k_msleep(THREAD_ACC_PERIODICITY);
	}
}

/* same as previous consumers but a modem simulation through UART */
void UART_ConsumerThread(void)
{
	while (1) {
		task_uart_push();
		/* thread periodicity */
		k_msleep(THREAD_MODEM_PERIODICITY);
	}
}

/* managing the fifo through that thread, dispatching messages and calling handlers that correspond to their message types */
void fifo_HandlerThread(void)
{
	while (1) {
		if (task_manage_msg() == ERR_INVALID_TYPE)
			printk("Message dispatcher fault!\n");
		/* thread periodicity */
		k_msleep(THREAD_FIFO_HANDLER_PERIODICITY);
	}
}

/* define and intialize 4 threads, 3 are demo threads to push simulated messages and the fifo handler thread */
/* the fifo handler thread */
K_THREAD_DEFINE(fifo_HandlerThread_id, STACKSIZE, fifo_HandlerThread, NULL, NULL, NULL, PRIORITY, 0,
		0);
K_THREAD_DEFINE(I2C_ConsumerThread_id, STACKSIZE, I2C_ConsumerThread, NULL, NULL, NULL, PRIORITY, 0,
		0);
K_THREAD_DEFINE(SPI_ConsumerThread_id, STACKSIZE, SPI_ConsumerThread, NULL, NULL, NULL, PRIORITY, 0,
		0);
K_THREAD_DEFINE(UART_ConsumerThread_id, STACKSIZE, UART_ConsumerThread, NULL, NULL, NULL, PRIORITY,
		0, 0);
```

## src/FifoHandler.c
```c
#include "FifoHandler.h"

/* 
* Fifo defintion, it is a ring buffer that has start and end pointers to keep track of the logged messages 
* in case the fifo is full, the oldest record is overwriten.
* the number of messages the fifo can store at the same time is defined by FIFO_MAX_SIZE definition
*/
static struct message_handler_def {
	int startPointer;
	int endPointer;
	struct messageFrame myMessageFrame[FIFO_MAX_SIZE];
} myMessageHandler;

/* array of function pointers that acts as callback handlers for different messages types */
static void (*messages_handler[MAX_NUM_OF_MSG_TYPES])(struct messageFrame *msg);

/* should be used from different threads to push messages from different subunits in the system */
err_codes message_push(struct messageFrame msg)
{
	err_codes err = ERR_OK;
	/* storing the incoming in the fifo */
	myMessageHandler.myMessageFrame[myMessageHandler.endPointer].messageType = msg.messageType;
	strcpy(myMessageHandler.myMessageFrame[myMessageHandler.endPointer].payload, msg.payload);
	myMessageHandler.endPointer++;
	/* using the ring buffer technique when endpointer exceed delimiter */
	if (myMessageHandler.endPointer >= FIFO_MAX_SIZE)
		myMessageHandler.endPointer = 0;
	/* erase the new message frame for the next message */
	memset((void *)&(myMessageHandler.myMessageFrame[myMessageHandler.endPointer]), 0,
	       sizeof(myMessageHandler.myMessageFrame[0]));
	/* fifo full? drop the oldest message */
	if (myMessageHandler.endPointer == myMessageHandler.startPointer) {
		myMessageHandler.startPointer++;
		/* loop if exceed delimiter also */
		if (myMessageHandler.startPointer >= FIFO_MAX_SIZE)
			myMessageHandler.startPointer = 0;
	}
	/* return error if fifo is empty after a push */
	if (myMessageHandler.endPointer == myMessageHandler.startPointer)
		err = ERR_UNKNOWN;

	return err;
}

/* 
* fetch the oldest message from fifo to the pointer in arrgument
* param is fifo message frame structure
* return ERR_OK upon success
*/
static err_codes message_pull(struct messageFrame *msg)
{
	err_codes err;
	err = ERR_OK;
	/* return empty if fifo is empty */
	if (myMessageHandler.endPointer == myMessageHandler.startPointer) {
		err = ERR_EMPTY;
		return err;
	}
	/* pull the oldest message frame from fifo to the frame pointer */
	*msg = myMessageHandler.myMessageFrame[myMessageHandler.startPointer];
	/* check frame sanity */
	if (strlen(msg->payload) == 0)
		err = ERR_EMPTY;
	if (msg->messageType > MAX_NUM_OF_MSG_TYPES || msg->messageType < 0)
		err = ERR_INVALID_TYPE;
	return err;
}

/* Remove the oldest message from fifo
*  return ERR_OK upon success
*/
static err_codes message_consume()
{
	err_codes err = ERR_OK;
	myMessageHandler.startPointer++;
	/* return empty error if fifo is empty */
	if (myMessageHandler.startPointer == myMessageHandler.endPointer) {
		err = ERR_EMPTY;
	}
	/* reach delimiter? loop back */
	if (myMessageHandler.startPointer >= FIFO_MAX_SIZE) {
		myMessageHandler.startPointer = 0;
	}
	return err;
}
/* 
* Pull messages from fifo and call corresponding message handler/consumer.
* it dispatches the message upon calling the handler
* return ERR_OK upon success, ERR_EMPTY if fifo empty & ERR
*/
err_codes task_manage_msg()
{
	struct messageFrame msg;
	/* pull the message frame */
	err_codes err = message_pull(&msg);
	if (err != ERR_OK)
		return err;
	/* call corresponding handler */
	messages_handler[msg.messageType](&msg);
	/* dispatch message frame */
	err = message_consume();
	return err;
}

/*
* assigning callback handlers for different message types
* return ERR_OK upon success
*/
err_codes fifo_register_callback(void (*handler)(struct messageFrame *msg), messageTypes num)
{
	err_codes err;
	err = ERR_OK;
	/* return error if pointer is NULL */
	if (handler == NULL)
		err = ERR_INVALID_TYPE;
	/* assign pointer to function to the matching data type index */
	messages_handler[num] = handler;
	return err;
}
```

## src/FifoHandler.h
```c
#ifndef FIFO_HANDLER_H
#define FIFO_HANDLER_H

#include <string.h>

/* max number of message frame the fifo will handle, only FIFO_MAX_SIZE-1 can be actually pulled  */
#define FIFO_MAX_SIZE 100
/* the size of longest string the might be used as a payload in the message frame */
#define MAX_PAYLOAD_LEN 50

#define MAX_NUM_OF_MSG_TYPES 10

/* 10 different messages types, if more types are need please add and update MAX_NUM_OF_MSG_TYPES definition */
typedef enum {
	MESS_TYPE_A = 0,
	MESS_TYPE_B,
	MESS_TYPE_C,
	MESS_TYPE_D,
	MESS_TYPE_E,
	MESS_TYPE_F,
	MESS_TYPE_G,
	MESS_TYPE_H,
	MESS_TYPE_I,
	MESS_TYPE_J,
	MESS_TYPE_K
} messageTypes;

/* message frame structure */
struct messageFrame {
	messageTypes messageType;
	char payload[MAX_PAYLOAD_LEN];
};

typedef enum { ERR_EMPTY, ERR_UNKNOWN, ERR_INVALID_TYPE, ERR_OK } err_codes;

err_codes task_manage_msg();
err_codes fifo_register_callback(void (*handler)(struct messageFrame *msg), messageTypes num);
err_codes message_push(struct messageFrame msg);

#endif
```

## src/I2C_sample.c
```c
#include "I2C_sample.h"
#include "FifoHandler.h"

/* pushing demo data to the fifo */
void task_temp_push()
{
	/* demo test temperature data */
	char *str = "{\"T\": \"25\"}";
	struct messageFrame temperature;
	temperature.messageType = MESS_TYPE_A;
	strcpy(temperature.payload, str);
	message_push(temperature);
}
```

## src/I2C_sample.h
```c
#ifndef I2C_SAMPLE_H
#define I2C_SAMPLE_H

void task_temp_push();

#endif
```

## src/SPI_sample.c
```c
#include "SPI_sample.h"
#include "FifoHandler.h"

/* pushing demo data to the fifo */
void task_acc_push()
{
	char *str = "{\"ACC\": \"true\"}";
	struct messageFrame accerlometer;
	accerlometer.messageType = MESS_TYPE_B;
	strcpy(accerlometer.payload, str);
	message_push(accerlometer);
}
```

## src/SPI_sample.h
```c
#ifndef SPI_SAMPLE_H
#define SPI_SAMPLE_H

void task_acc_push();

#endif
```

## src/UART_sample.c
```c
#include "UART_sample.h"
#include "FifoHandler.h"

/* pushing demo data to the fifo */
void task_uart_push()
{
	char *str = "{\"GPS\": \"30.3123213,31.231231\"}";
	struct messageFrame GPS;
	GPS.messageType = MESS_TYPE_C;
	strcpy(GPS.payload, str);
	message_push(GPS);
}
```

## src/UART_sample.h
```c
#ifndef UART_SAMPLE_H
#define UART_SAMPLE_H

void task_uart_push();

#endif
```
